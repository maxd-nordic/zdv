## CMakeLists.txt
```
# SPDX-License-Identifier: Apache-2.0

cmake_minimum_required(VERSION 3.13.1)

find_package(Zephyr REQUIRED HINTS $ENV{ZEPHYR_BASE})
project(zdv)

target_sources(app PRIVATE src/main.c)
```

## Kconfig
```
config STARTUP_SLEEP
        int "Number of microseconds to sleep at start-up"
        default 0

source "Kconfig.zephyr"
```

## west.yml
```
# Copyright (c) 2021 Nordic Semiconductor ASA
# SPDX-License-Identifier: Apache-2.0

manifest:
  self:
    west-commands: scripts/west-commands.yml
    path: zdv

  remotes:
    - name: ncs
      url-base: https://github.com/nrfconnect

  projects:
    - name: nrf
      remote: ncs
      repo-path: sdk-nrf
      revision: v2.3.0
      import: true
```

## prj.conf
```kconfig
# SPDX-License-Identifier: Apache-2.0

CONFIG_BOOT_BANNER=n
CONFIG_BUILD_OUTPUT_HEX=y
CONFIG_SERIAL=y
CONFIG_UART_CONSOLE=y
```

## boards/bbc_microbit_v2.conf
```kconfig
CONFIG_BUILD_OUTPUT_UF2=y
CONFIG_BUILD_OUTPUT_UF2_FAMILY_ID="0x621e937a"
```

## boards/lpcxpresso55s69_cpu0.conf
```kconfig
# SPDX-License-Identifier: Apache-2.0
CONFIG_FLASH_BASE_ADDRESS=0x0
CONFIG_BUILD_OUTPUT_UF2=y
```

## boards/mimxrt1050_evk.conf
```kconfig
CONFIG_STARTUP_SLEEP=20000
CONFIG_BUILD_OUTPUT_UF2=y
```

## boards/mimxrt1060_evk.conf
```kconfig
CONFIG_STARTUP_SLEEP=10000
CONFIG_BUILD_OUTPUT_UF2=y
```

## boards/nrf52dk_nrf52832.conf
```kconfig
CONFIG_BUILD_OUTPUT_UF2=y
CONFIG_BUILD_OUTPUT_UF2_FAMILY_ID="0x1b57745f"
```

## src/main.c
```c
/*
 * SPDX-License-Identifier: Apache-2.0
 */

#include <zephyr/kernel.h>
#include <zephyr/sys/printk.h>
#include <zephyr/device.h>
#include <zephyr/drivers/uart.h>
#include <stdio.h>
#include <stdlib.h>
#include <string.h>

void main(void)
{
    const struct device *uart = DEVICE_DT_GET(DT_CHOSEN(zephyr_console));
    struct uart_config cfg;
    char buffer[64];
    uint32_t index = 0;
    char c;

    if (uart == NULL) {
        printk("Error acquiring UART");
        k_oops();
    }
    uart_config_get(uart, &cfg);

#if defined(CONFIG_STARTUP_SLEEP) && (CONFIG_STARTUP_SLEEP > 0)
    k_busy_wait(CONFIG_STARTUP_SLEEP);
#endif

    printf("{init}");

    while (1) {
        if (uart_poll_in(uart, &c) == 0) {
            putchar(c);
            if (c == '{') {
                buffer[0] = 0;
                index = 0;
            } else if (c == '}') {
                if (memcmp(buffer, "baud:", 5) == 0) {
                    int baud = atoi(&buffer[5]);
                    if(baud > 0) {
                        k_busy_wait(1000);
                        cfg.baudrate = baud;
                        uart_configure(uart, &cfg);
                        k_busy_wait(1000);
                        printf("{change}");
                    }
                    buffer[0] = 0;
                    index = 0;
                }
            } else if (index < sizeof(buffer) - 1) {
                buffer[index++] = c;
            }
        }
    }
}
```
